## main/Kconfig.projbuild
```kconfig
menu "esp32-ota-update Configuration"

    config WIFI_SSID
        string "WiFi SSID"
        default "myssid"
        help
            SSID of the access point to connect to.

    config WIFI_PASSWORD
        string "WiFi password"
        default "mypassword"
        help
            WPA2 password of the access point.

    config WIFI_MAX_RETRY
        int "Maximum connection retries"
        default 5
        help
            Number of reconnection attempts before giving up.

    config DHT_GPIO
        int "DHT22 data GPIO"
        default 4
        help
            GPIO number wired to the DHT22 data line.

    config DHT_INTERVAL_MS
        int "Sensor sampling interval (ms)"
        default 2000
        help
            Delay between two sensor readings. The DHT22 needs at least
            2000 ms between samples, so do not go below that.

    config MDNS_HOSTNAME
        string "mDNS hostname"
        default "esp32"
        help
            The board answers to <hostname>.local on the local network.
            Letters, digits and hyphens only.

    config OTA_UPDATE_URL
        string "OTA firmware URL"
        default "http://192.168.1.100:8070/esp32-ota-update.bin"
        help
            HTTP URL of the firmware image to download. Must be reachable
            from the board's network.

    config OTA_RECV_TIMEOUT_MS
        int "OTA receive timeout (ms)"
        default 10000
        help
            Timeout for a single HTTP read. A stalled download aborts
            after this many milliseconds.
    
    config SELF_TEST_TIMEOUT_MS
        int "Self-test sensor timeout (ms)"
        default 8000
        help
            How long the post-boot health check waits for the first valid
            sensor reading before declaring the firmware broken. Must be
            longer than the sensor task's start-up delay plus a few
            sampling intervals.

endmenu
```

## sdkconfig.defaults
```kconfig
CONFIG_ESPTOOLPY_FLASHSIZE_4MB=y
CONFIG_PARTITION_TABLE_CUSTOM=y
CONFIG_PARTITION_TABLE_CUSTOM_FILENAME="partitions.csv"
CONFIG_BOOTLOADER_APP_ROLLBACK_ENABLE=y
```
