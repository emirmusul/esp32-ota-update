#include <math.h>
#include <string.h>

#include "esp_app_desc.h"
#include "esp_log.h"
#include "esp_http_server.h"
#include "esp_ota_ops.h"
#include "esp_timer.h"
#include "cJSON.h"

#include "boot_info.h"
#include "http_server.h"
#include "sensor.h"
#include "ota.h"

static const char *TAG = "http_server";

/* Symbols generated by the linker for every file listed in EMBED_FILES.
   These are addresses in flash, not RAM buffers. The asm() label maps the
   mangled linker symbol onto a readable C identifier. */
extern const uint8_t index_html_start[] asm("_binary_index_html_start");
extern const uint8_t index_html_end[]   asm("_binary_index_html_end");
extern const uint8_t style_css_start[]  asm("_binary_style_css_start");
extern const uint8_t style_css_end[]    asm("_binary_style_css_end");
extern const uint8_t app_js_start[]     asm("_binary_app_js_start");
extern const uint8_t app_js_end[]       asm("_binary_app_js_end");
extern const uint8_t favicon_svg_start[] asm("_binary_favicon_svg_start");
extern const uint8_t favicon_svg_end[]   asm("_binary_favicon_svg_end");

typedef struct {
    const char    *uri;
    const char    *content_type;
    const uint8_t *start;
    const uint8_t *end;
} static_asset_t;

/* Adding a new file means adding one row here plus one line in CMakeLists. */
static const static_asset_t s_assets[] = {
    { "/",           "text/html",              index_html_start, index_html_end },
    { "/index.html", "text/html",              index_html_start, index_html_end },
    { "/style.css",  "text/css",               style_css_start,  style_css_end  },
    { "/app.js",     "application/javascript", app_js_start,     app_js_end     },
    { "/favicon.svg", "image/svg+xml",         favicon_svg_start, favicon_svg_end },
};

#define ASSET_COUNT (sizeof(s_assets) / sizeof(s_assets[0]))

/* Catch-all handler for every GET request. */
static esp_err_t static_get_handler(httpd_req_t *req)
{
    for (size_t i = 0; i < ASSET_COUNT; i++) {
        if (strcmp(req->uri, s_assets[i].uri) != 0) {
            continue;
        }

        const size_t len = s_assets[i].end - s_assets[i].start;

        ESP_LOGI(TAG, "GET %s -> %u bytes, type %s, fd %d",
                 req->uri, (unsigned) len, s_assets[i].content_type,
                 httpd_req_to_sockfd(req));

        httpd_resp_set_type(req, s_assets[i].content_type);
        /* Development only: stop the browser from reusing a stale copy
           after the firmware is reflashed. */
        httpd_resp_set_hdr(req, "Cache-Control", "no-store");

        return httpd_resp_send(req, (const char *) s_assets[i].start, len);
    }

    ESP_LOGW(TAG, "No asset registered for %s", req->uri);
    httpd_resp_send_err(req, HTTPD_404_NOT_FOUND, "Asset not found");

    // A 404 is a valid response, not a handler failure. Returning ESP_FAIL
    // would make httpd log "uri handler execution failed" and close the
    // socket, forcing the browser into a new TCP handshake for the next
    // request on what should have been a kept-alive connection.
    return ESP_OK;
}

/* GET /api/version — what is running right now.
   The browser uses this to notice that a reboot has happened and that the
   image on the other side of it is different, which is the only way it can
   tell a successful update from a rollback. */
static esp_err_t version_get_handler(httpd_req_t *req)
{
    httpd_resp_set_type(req, "application/json");
    httpd_resp_set_hdr(req, "Cache-Control", "no-store");

    const esp_app_desc_t  *desc    = esp_app_get_description();
    const esp_partition_t *running = esp_ota_get_running_partition();

    esp_ota_img_states_t state;
    const char *state_str = "UNKNOWN";
    if (esp_ota_get_state_partition(running, &state) == ESP_OK) {
        state_str = boot_info_state_str(state);
    }

    cJSON *root = cJSON_CreateObject();
    if (root == NULL) {
        return httpd_resp_send_500(req);
    }

    char built[40];
    snprintf(built, sizeof(built), "%s %s", desc->date, desc->time);

    cJSON_AddStringToObject(root, "version", desc->version);
    cJSON_AddStringToObject(root, "project", desc->project_name);
    cJSON_AddStringToObject(root, "built", built);
    cJSON_AddStringToObject(root, "slot", running->label);
    cJSON_AddStringToObject(root, "state", state_str);
    /* First bytes of the ELF digest, enough to tell two builds apart when
   the version string and the compile timestamp are identical. */
    char sha[17];
    for (int i = 0; i < 8; i++) {
        snprintf(sha + i * 2, 3, "%02x", desc->app_elf_sha256[i]);
    }
    cJSON_AddStringToObject(root, "elf_sha", sha);
    cJSON_AddNumberToObject(root, "uptime_s",
                            (double) (esp_timer_get_time() / 1000000));

    char *body = cJSON_PrintUnformatted(root);
    cJSON_Delete(root);

    if (body == NULL) {
        return httpd_resp_send_500(req);
    }

    esp_err_t err = httpd_resp_send(req, body, HTTPD_RESP_USE_STRLEN);
    cJSON_free(body);
    return err;
}

static const httpd_uri_t version_uri = {
    .uri      = "/api/version",
    .method   = HTTP_GET,
    .handler  = version_get_handler,
    .user_ctx = NULL,
};

/* POST /api/ota — starts a firmware update in the background.
   Responds before the download begins: the update takes about 15 seconds
   and ends in a reboot, so holding the connection open would only make
   the client time out. */
static esp_err_t ota_post_handler(httpd_req_t *req)
{
    ESP_LOGI(TAG, "POST /api/ota from fd %d", httpd_req_to_sockfd(req));

    httpd_resp_set_type(req, "application/json");
    httpd_resp_set_hdr(req, "Cache-Control", "no-store");

    esp_err_t err = ota_trigger_async();

    if (err == ESP_ERR_INVALID_STATE) {
        httpd_resp_set_status(req, "409 Conflict");
        return httpd_resp_send(req, "{\"error\":\"update already running\"}",
                               HTTPD_RESP_USE_STRLEN);
    }

    if (err != ESP_OK) {
        httpd_resp_set_status(req, "500 Internal Server Error");
        return httpd_resp_send(req, "{\"error\":\"could not start update\"}",
                               HTTPD_RESP_USE_STRLEN);
    }

    httpd_resp_set_status(req, "202 Accepted");
    return httpd_resp_send(req, "{\"status\":\"update started\"}",
                           HTTPD_RESP_USE_STRLEN);
}

static const httpd_uri_t ota_uri = {
    .uri      = "/api/ota",
    .method   = HTTP_POST,
    .handler  = ota_post_handler,
    .user_ctx = NULL,
};


// Returns the most recent sensor sample as JSON. The sensor itself is polled
// by a background task, so this handler never touches the hardware and
// returns within microseconds.
static esp_err_t sensor_get_handler(httpd_req_t *req)
{
    sensor_reading_t reading;

    httpd_resp_set_type(req, "application/json");
    httpd_resp_set_hdr(req, "Cache-Control", "no-store");

    if (!sensor_get_latest(&reading)) {
        ESP_LOGW(TAG, "GET /api/sensor before the first successful reading");
        httpd_resp_set_status(req, "503 Service Unavailable");
        return httpd_resp_send(req, "{\"error\":\"no reading yet\"}",
                               HTTPD_RESP_USE_STRLEN);
    }

    const int64_t age_ms = (esp_timer_get_time() - reading.timestamp_us) / 1000;

    cJSON *root = cJSON_CreateObject();
    if (root == NULL) {
        return httpd_resp_send_500(req);
    }

    // The sensor is only accurate to 0.1 units, and a float promoted to
    // double exposes its binary rounding error (26.4f prints as
    // 26.399999618530273). Round in double space so cJSON emits one decimal.
    const double temperature = round((double) reading.temperature * 10.0) / 10.0;
    const double humidity    = round((double) reading.humidity * 10.0) / 10.0;

    cJSON_AddNumberToObject(root, "temperature", temperature);
    cJSON_AddNumberToObject(root, "humidity", humidity);
    cJSON_AddNumberToObject(root, "age_ms", (double) age_ms);

    char *body = cJSON_PrintUnformatted(root);
    cJSON_Delete(root);

    if (body == NULL) {
        return httpd_resp_send_500(req);
    }

    ESP_LOGI(TAG, "GET /api/sensor -> %.1f C, %.1f %%, age %lld ms, fd %d",
             reading.temperature, reading.humidity, age_ms,
             httpd_req_to_sockfd(req));

    esp_err_t err = httpd_resp_send(req, body, HTTPD_RESP_USE_STRLEN);
    cJSON_free(body);
    return err;
}

static const httpd_uri_t sensor_uri = {
    .uri      = "/api/sensor",
    .method   = HTTP_GET,
    .handler  = sensor_get_handler,
    .user_ctx = NULL,
};

static const httpd_uri_t static_uri = {
    .uri      = "/*",
    .method   = HTTP_GET,
    .handler  = static_get_handler,
    .user_ctx = NULL,
};

httpd_handle_t http_server_start(void)
{
    httpd_config_t config = HTTPD_DEFAULT_CONFIG();
    config.lru_purge_enable = true;
    config.uri_match_fn     = httpd_uri_match_wildcard;

    httpd_handle_t server = NULL;

    ESP_LOGI(TAG, "Starting HTTP server on port %d", config.server_port);

    esp_err_t err = httpd_start(&server, &config);
    if (err != ESP_OK) {
        ESP_LOGE(TAG, "httpd_start failed: %s", esp_err_to_name(err));
        return NULL;
    }

    // Registration order matters: httpd returns the first matching handler,
    // so the "/*" catch-all must always be registered last.
    ESP_ERROR_CHECK(httpd_register_uri_handler(server, &sensor_uri));
    ESP_ERROR_CHECK(httpd_register_uri_handler(server, &version_uri));
    ESP_ERROR_CHECK(httpd_register_uri_handler(server, &ota_uri));
    ESP_ERROR_CHECK(httpd_register_uri_handler(server, &static_uri));

    ESP_LOGI(TAG, "Server started, %u asset(s) available", (unsigned) ASSET_COUNT);
    return server;
}

void http_server_stop(httpd_handle_t server)
{
    if (server != NULL) {
        httpd_stop(server);
    }
}